## config/west.yml
```yaml
manifest:
  remotes:
    - name: zmkfirmware
      url-base: https://github.com/scrthq
  projects:
    - name: zmk
      remote: zmkfirmware
      revision: corne-ish-zen-plus-macros
      import: app/west.yml
  self:
    path: config
```
