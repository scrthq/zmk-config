/*
*
* Copyright (c) 2021 scrthq
* SPDX-License-Identifier: MIT
*
*/

#include <dt-bindings/zmk/keys.h>
#include <dt-bindings/zmk/bt.h>

#if (__has_include("local_macros.dtsi"))
    #include "local_macros.dtsi"
#else
    #define mac_rtyu <&kp R>, <&kp T>, <&kp Y>, <&kp U>
    #define mac_gh <&kp G>, <&kp H>
    #define test_zeroes <&kp T>
    #define mac_tl <&kp T>, <&kp L>
#endif

#define OS_QWERTY(LAYER) \
            < \
                &kp TAB           &kp Q    &kp W    &kp E    &kp R    &kp T        &kp Y    &kp U    &kp I    &kp O    &kp P    &kp BKSP          \
                &lt LAYER MINUS    &kp A    &kp S    &kp D    &kp F    &kp G        &kp H    &kp J    &kp K    &kp L    &kp SEMI &kp SQT           \
                &mt LSHIFT LPAR   &kp Z    &kp X    &kp C    &kp V    &kp B        &kp N    &kp M    &kp CMMA &kp DOT  &kp FSLH &mt RSHIFT RPAR   \
                        &kp LGUI &lt NUMROW SPC &mt LCTL SPC                           &mt LALT ENTER &lt ADJUST LEFT_ARROW &mt LA(LCTL) RIGHT_ARROW          \
            >

#define WNDOWS 0
#define MACOSX 1
#define GAMING 2
#define NUMPAD 3
#define NUMROW 4
#define ADJUST 5
#define CONFIG 6
#define WINKEY 7
#define MACKEY 8
